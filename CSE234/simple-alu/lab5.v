
//=======================================================
//  This code is generated by Terasic System Builder
//=======================================================

module lab5(

	//////////// CLOCK //////////
	input 		          		CLOCK_50,

	//////////// KEY //////////
	input 		     [3:0]		KEY,

	//////////// LED //////////
	output		     [9:0]		LEDR,

	//////////// SW //////////
	input 		     [9:0]		SW
);

	wire [4:0] out;
	wire [4:0] cur;
	wire [4:0] sum;
	wire [4:0] shr;
	wire [31:0] cnt;
	
	counter ct1(CLOCK_50, cnt);
	
	register_5bit(CLOCK_50, KEY[0], out, cur);
	Add(cur, SW[9:5], sum);
	shift_reg(SW[9:5], CLOCK_50, SW[4], shr);
	MUX_5bit(cur, sum, shr, SW[9:5], SW[0], SW[1], out);
	
	assign LEDR[4:0] = out;
endmodule

module MUX_5bit(input [4:0] A, input [4:0] B, input [4:0] C, input [4:0] D, input S0, input S1, output [4:0] out);
	assign out = (A & ~S0 & ~S1) | (B & S0 & ~S1) | (C & ~S0 & S1) | (D & S0 & S1);
endmodule

module MUX(input [3:0] I, input [3:0] Q, input load, output [3:0] Y);
	assign Y = load ? I : Q;
endmodule

module register_5bit(input clk, input load, input [3:0] I, output reg [3:0] Q);
	wire [3:0]out;
	MUX(I, Q, load, out);
	
	always @(posedge clk)
	begin	
		Q <= out;
	end
	
endmodule

module counter(input clk, output reg[31:0] count);
	
	always @(posedge clk)
	begin
		count = count + 32'b1;
	end
endmodule

module Add(
    input [4:0] A, 
    input [4:0] B, 
    output [4:0] SUM
    );
    
    assign SUM = A +  B;
    
endmodule

module shift_reg(input [4:0] I, input clk,input sw, output reg[4:0] Q);
	
	wire[4:0] wr;
	
	MUX_5bit2x1(I[4],0,sw,wr[4]);
	MUX_5bit2x1(I[3],wr[4],sw,wr[3]);
	MUX_5bit2x1(I[2],wr[3],sw,wr[2]);
	MUX_5bit2x1(I[1],wr[2],sw,wr[1]);
	MUX_5bit2x1(I[0],wr[1],sw,wr[0]);
	
	always @(posedge clk)begin
		Q <= wr;
	end
endmodule

module MUX_5bit2x1(input in2, input in1, input sw, output out);
	assign out = sw ? in2 : in1;
endmodule

